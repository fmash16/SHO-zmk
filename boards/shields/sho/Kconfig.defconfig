## boards/shields/sho/Kconfig.defconfig
```kconfig
if SHIELD_SHO_RIGHT

config ZMK_KEYBOARD_NAME
    default "sho"

config ZMK_SPLIT_BLE_ROLE_CENTRAL
	default y
    
endif

if SHIELD_SHO_LEFT || SHIELD_SHO_RIGHT

config ZMK_SPLIT
    default y

endif
```

## config/boards/shields/sho/Kconfig.defconfig
```kconfig
# Copyright (c) 2020 The ZMK Contributors
# SPDX-License-Identifier: MIT

if SHIELD_SHO_LEFT

config ZMK_KEYBOARD_NAME
	default "SHO"

config ZMK_SPLIT_ROLE_CENTRAL
	default y

endif

if SHIELD_SHO_LEFT || SHIELD_SHO_RIGHT

config ZMK_SPLIT
	default y

endif
```

## config/boards/shields/sho/Kconfig.shield
```kconfig
# Copyright (c) 2020 The ZMK Contributors
# SPDX-License-Identifier: MIT

config SHIELD_SHO_LEFT
    def_bool $(shields_list_contains,sho_left)

config SHIELD_SHO_RIGHT
    def_bool $(shields_list_contains,sho_right)
```

## config/west.yml
```yaml
manifest:
  remotes:
    - name: zmkfirmware
      url-base: https://github.com/zmkfirmware
    - name: petejohanson
      url-base: https://github.com/petejohanson/
  # projects:
  #   - name: zmk
  #     remote: zmkfirmware
  #     revision: main
  #     import: app/west.yml
  projects:
    - name: zmk
      remote: zmkfirmware 
      revision: feat/pointers-move-scroll
      import: app/west.yml
  self:
    path: config
```
